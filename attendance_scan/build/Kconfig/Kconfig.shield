## attendance_scan/build/Kconfig/Kconfig.shield
```kconfig
osource "/Users/Isaac/nrf_apps/397_Attendance/attendance_scan/boards/shields/*/Kconfig.shield"
osource "/Users/Isaac/nrf_apps/397_Attendance/attendance_scan/boards/shields/*/Kconfig.shield"
osource "/opt/nordic/ncs/v1.9.1/nrf/boards/shields/*/Kconfig.shield"
```

## attendance_scan/build/Kconfig/Kconfig.shield.defconfig
```kconfig
osource "/Users/Isaac/nrf_apps/attendance_scan/boards/shields/*/Kconfig.defconfig"
osource "/Users/Isaac/nrf_apps/attendance_scan/boards/shields/*/Kconfig.defconfig"
osource "/opt/nordic/ncs/v1.9.1/nrf/boards/shields/*/Kconfig.defconfig"
```
